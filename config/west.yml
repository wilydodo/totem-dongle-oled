## config/west.yml
```yaml
manifest:
  remotes:
    - name: zmkfirmware
      url-base: https://github.com/zmkfirmware
    - name: wilydodo
      url-base: https://github.com/wilydodo

  projects:
    - name: zmk
      remote: zmkfirmware
      revision: main
      import: app/west.yml

    - name: zmk-dongle-display
      remote: wilydodo
      revision: main

  self:
    path: config
```
